## conf/distro/IVI.conf
```bitbake
include conf/distro/b2qt.conf
require conf/distro/sota.conf.inc

DISTRO = "IVI"
DISTRO_NAME = "In-Vehicle Infotainment"
DISTRO_VERSION = "0.8.0"
SDK_VERSION := "0.8"

MAINTAINER = "Solar Team Eindhoven <steven.vanderschoot@solarteameindhoven.nl>"

OSTREE_OSNAME = "${DISTRO}"

DISTRO_FEATURES += "pulseaudio ipsec ipv6 nfs smbfs usbgadget usbhost webengine wifi"

KERNEL_DEVICETREE += "overlays/ad7998.dtbo"
#KERNEL_INITRAMFS = "-initramfs"
#RPI_USE_U_BOOT = "1"
```

## conf/layer.conf
```bitbake
# We have a conf and classes directory, append to BBPATH
BBPATH .= ":${LAYERDIR}"

# We have a recipes directory containing .bb and .bbappend files, add to BBFILES
BBFILES += "${LAYERDIR}/recipes*/*/*.bb \
            ${LAYERDIR}/recipes*/*/*.bbappend"

BBFILE_COLLECTIONS += "layr"
BBFILE_PATTERN_layr := "^${LAYERDIR}/"
BBFILE_PRIORITY_layr = "11"

# Additional license directories.
LICENSE_PATH += "${LAYERDIR}/files/custom-licenses"

STE_GIT ?= "gitsm://git@github.com/SolarTeamEindhoven"
STE_GIT_PROTOCOL ?= "ssh"
```
